## conf/distro/myir-image.conf
```bitbake
# Nuvoton DISTRO for the FrameBuffer graphical backend.

include conf/distro/include/nvt-base.inc

DISTRO = "myir-image"

# Remove conflicting backends.
DISTRO_FEATURES_append += ""
```

## conf/layer.conf
```bitbake
# We have a conf and classes directory, add to BBPATH
BBPATH .= ":${LAYERDIR}"

# We have a recipes-* directories, add to BBFILES
BBFILES += "${LAYERDIR}/recipes-*/*/*.bb \
            ${LAYERDIR}/recipes-*/*/*.bbappend"

BBFILE_COLLECTIONS += "myir-layer"
BBFILE_PATTERN_myir-layer := "^${LAYERDIR}/"
BBFILE_PRIORITY_myir-layer = "9"

# This should only be incremented on significant changes that will
# cause compatibility issues with other layers
LAYERVERSION_myir-layer = "1"
LAYERSERIES_COMPAT_myir-layer = "dunfell"

# for optee-os-ma35d1 dependency
LAYERDEPENDS_myir-layer = "core openembedded-layer meta-python"
LAYERDEPENDS_myir-layer += " qt5-layer "

# docker 
#CORE_IMAGE_EXTRA_INSTALL = "libcgroup cgroup-lite docker net-tools ca-certificates ffmpeg gstreamer1.0 gstreamer1.0-plugins-base"

CORE_IMAGE_EXTRA_INSTALL += " ${@bb.utils.contains('DISTRO_FEATURES', 'alsa', 'alsa-utils', '', d)} "
CORE_IMAGE_EXTRA_INSTALL += " ${@bb.utils.contains('DISTRO_FEATURES', '8189es', 'wpa-supplicant', '', d)} "
CORE_IMAGE_EXTRA_INSTALL += " ${@bb.utils.contains('DISTRO_FEATURES', '8192es', 'wpa-supplicant', '', d)} "
CORE_IMAGE_EXTRA_INSTALL += " ${@bb.utils.contains('DISTRO_FEATURES', 'directfb', 'directfb', '', d)} "
CORE_IMAGE_EXTRA_INSTALL += " ${@bb.utils.contains('DISTRO_FEATURES', 'gc520', 'gc520', '', d)} "
CORE_IMAGE_EXTRA_INSTALL += " ${@bb.utils.contains('DISTRO_FEATURES', 'dcultrafb', 'dcultrafb', '', d)} "
CORE_IMAGE_EXTRA_INSTALL += " ${@bb.utils.contains('DISTRO_FEATURES', 'vc8000', 'vc8000', '', d)} "
CORE_IMAGE_EXTRA_INSTALL += " ${@bb.utils.contains('IMAGE_FSTYPES', 'sdcard', 'e2fsprogs-resize2fs e2fsprogs-mke2fs parted', '', d)} "
CORE_IMAGE_EXTRA_INSTALL += " ${@bb.utils.contains('IMAGE_FSTYPES', 'nand', 'mtd-utils-ubifs', '', d)} "
CORE_IMAGE_EXTRA_INSTALL += " ${@bb.utils.contains('IMAGE_FSTYPES', 'spinand', 'mtd-utils-ubifs', '', d)} "
CORE_IMAGE_EXTRA_INSTALL += " ${@bb.utils.contains('MACHINE_FEATURES', 'optee', 'optee-client optee-examples optee-test', '', d)} "
```
